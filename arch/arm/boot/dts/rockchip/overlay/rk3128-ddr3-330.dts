// SPDX-License-Identifier: (GPL-2.0+ OR MIT)
/*
 * Force a fixed 330 MHz DDR clock on RK3128.
 * Effective DDR data rate is 660 MT/s.
 */

/dts-v1/;
/plugin/;

#include <dt-bindings/soc/rockchip-system-status.h>

/ {
	fragment@0 {
		target = <&dmc>;
		__overlay__ {
			status = "okay";
			auto-freq-en = <0>;
			system-status-freq = <SYS_STATUS_NORMAL 330000>;
			dram_freq = <330000000>;
		};
	};

	fragment@1 {
		target = <&dmc_opp_table>;
		__overlay__ {
			opp-330000000 {
				opp-hz = /bits/ 64 <330000000>;
				opp-microvolt = <1050000>;
			};
		};
	};
};
